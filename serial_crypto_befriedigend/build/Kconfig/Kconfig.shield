## serial_crypto_befriedigend/build/Kconfig/Kconfig.shield
```kconfig
osource "/home/eternaldarkness/zephyrproject/zephyr/boards/shields/*/Kconfig.shield"
```

## serial_crypto_befriedigend/build/Kconfig/Kconfig.soc.defconfig
```kconfig
osource "/home/eternaldarkness/zephyrproject/zephyr/soc/$(ARCH)/*/Kconfig.defconfig"
```

## serial_crypto_genuegend/build/Kconfig/Kconfig.soc.arch
```kconfig
osource "/home/eternaldarkness/zephyrproject/zephyr/soc/$(ARCH)/Kconfig"
osource "/home/eternaldarkness/zephyrproject/zephyr/soc/$(ARCH)/*/Kconfig"
```

## serial_crypto_gut/build/Kconfig/Kconfig.modules
```kconfig
menu "hal_nordic (/home/eternaldarkness/zephyrproject/modules/hal/nordic)"
osource "$(ZEPHYR_HAL_NORDIC_KCONFIG)"
config ZEPHYR_HAL_NORDIC_MODULE
	bool
	default y
endmenu
menu "sof (/home/eternaldarkness/zephyrproject/modules/audio/sof)"
osource "/home/eternaldarkness/zephyrproject/modules/audio/sof/zephyr/Kconfig"
config ZEPHYR_SOF_MODULE
	bool
	default y
endmenu
menu "trusted-firmware-m (/home/eternaldarkness/zephyrproject/modules/tee/tfm)"
osource "$(ZEPHYR_TRUSTED_FIRMWARE_M_KCONFIG)"
config ZEPHYR_TRUSTED_FIRMWARE_M_MODULE
	bool
	default y
endmenu
menu "nanopb (/home/eternaldarkness/zephyrproject/modules/lib/nanopb)"
osource "$(ZEPHYR_NANOPB_KCONFIG)"
config ZEPHYR_NANOPB_MODULE
	bool
	default y
endmenu
```
